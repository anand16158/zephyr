## subsys/mgmt/mcumgr/transport/Kconfig.spi
```kconfig
#
# Copyright (c) 2026 Zephyr Project Contributors
#
# SPDX-License-Identifier: Apache-2.0
#

# The Kconfig file is dedicated to the SPI transport of the MCUmgr
# subsystem and provides Kconfig options to control aspects of
# the transport.
#
# Options defined in this file should be prefixed with:
#  MCUMGR_TRANSPORT_SPI_

menuconfig MCUMGR_TRANSPORT_SPI
	bool "SPI MCUmgr SMP transport"
	depends on SPI
	depends on GPIO
	help
	  Enables handling of SMP commands received over SPI. The device operates
	  as an SPI peripheral (slave) and uses a GPIO "ready" line to signal the
	  controller (master) that a response is available. A dedicated thread
	  continuously listens for incoming SPI transactions.

if MCUMGR_TRANSPORT_SPI

config MCUMGR_TRANSPORT_SPI_MTU
	int "SPI SMP MTU"
	default 256
	help
	  Maximum size of SMP frames sent and received over SPI, in bytes.
	  This value must satisfy the following relation:
	  MCUMGR_TRANSPORT_SPI_MTU <= MCUMGR_TRANSPORT_NETBUF_SIZE

config MCUMGR_TRANSPORT_SPI_RX_THREAD_STACK_SIZE
	int "SPI SMP RX thread stack size"
	default 1024
	help
	  Stack size of the SPI SMP transport receive thread.

config MCUMGR_TRANSPORT_SPI_RX_THREAD_PRIO
	int "SPI SMP RX thread priority"
	default 3
	help
	  Scheduling priority of the SPI SMP transport receive thread.

config MCUMGR_TRANSPORT_SPI_REASSEMBLY
	bool "Reassemble SPI SMP messages"
	select MCUMGR_TRANSPORT_REASSEMBLY
	help
	  Will reassemble SPI messages to allow for messages larger than a single
	  SPI transaction to be received. If disabled, each SPI transaction must
	  contain a complete SMP packet.

module = MCUMGR_TRANSPORT_SPI
module-str = SPI MCUmgr SMP transport
source "subsys/logging/Kconfig.template.log_config"

endif # MCUMGR_TRANSPORT_SPI
```
